/*
 * SPDX-License-Identifier: GPL-2.0-only
 *
 * Minimal DTS syntax test for the 7530 FON node against a mainline
 * qcom-ipq4019.dtsi.  This is not the board DTS; the real board change is
 * openwrt/target/linux/ipq40xx/patches-6.12/
 * 900-arm-dts-ipq4019-fritzbox-7530-fon.patch.
 */
/dts-v1/;

#include "qcom-ipq4019.dtsi"

/ {
	model = "AVM FRITZ!Box 7530 FON DTS test";
	compatible = "avm,fritzbox-7530";

	soc {
		fon_tdm: fon-tdm@7700000 {
			compatible = "avm,fon-tdm";
			reg = <0x07700000 0x34>,
			      <0x07704000 0x2000>,
			      <0x07708000 0x1000>,
			      <0x0770e000 0x1000>,
			      <0x07709000 0x1000>,
			      <0x0770f000 0x1000>;
			reg-names = "adss", "pcm", "mbox_tx", "mbox_rx",
				    "stereo_tx", "stereo_rx";
			qcom,tdm-slots = <8>;
			interrupts = <0 156 0>, <0 159 0>;
			interrupt-names = "mbox0", "mbox3";
			status = "disabled";
		};
	};
};
